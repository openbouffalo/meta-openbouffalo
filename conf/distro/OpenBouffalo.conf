## conf/distro/OpenBouffalo.conf
```bitbake
# Distribution definition for: OpenBouffalo
#

require conf/distro/poky.conf
require conf/distro/include/gcsections.inc

DISTRO = "OpenBouffalo"
DISTRO_NAME="OpenBouffalo"
DISTRO_VERSION="0.0.1"
DISTROOVERRIDES = "poky:poky-tiny"

SDK_VENDOR = "-bflb"

TARGET_VENDOR = "-bflb"

MAINTAINER = "https://github.com/openbouffalo/"

TCLIBC = "glibc"

FULL_OPTIMIZATION="-Os -pipe ${DEBUG_FLAGS}"

POKY_DEFAULT_EXTRA_RRECOMMENDS = ""

# FIXME: what should we do with this?
TCLIBCAPPEND = ""


# Drop native language support. This removes the
# eglibc->bash->gettext->libc-posix-clang-wchar dependency.
USE_NLS="no"

# Comment out any of the lines below to disable them in the build
# DISTRO_FEATURES options:
# alsa bluetooth ext2 pcmcia usbgadget usbhost wifi nfs zeroconf pci
DISTRO_FEATURES_CORE = " acl largefile pam sysvinit multiarch lto"
DISTRO_FEATURES_FS = " largefile smbfs vfat nfs"
DISTRO_FEATURES_NET = " ipv4 ipv6 zeroconf ppp "
DISTRO_FEATURES_USB = "usbhost"
DISTRO_FEATURES_USBGADGET = "usbgadget"
#DISTRO_FEATURES_WIFI = "wifi"

DISTRO_FEATURES = "${DISTRO_FEATURES_CORE} \
                   ${DISTRO_FEATURES_NET} \
                   ${DISTRO_FEATURES_USB} \
                   ${DISTRO_FEATURES_USBGADGET} \
                   ${DISTRO_FEATURES_WIFI} \
                  "

DISTRO_FEATURES:remove = "wayland x11 vulkan opengl"
DISTRO_FEATURES:class-native = "${DISTRO_FEATURES_DEFAULT} ${POKY_DEFAULT_DISTRO_FEATURES}"
DISTRO_FEATURES:class-nativesdk = "${DISTRO_FEATURES_DEFAULT} ${POKY_DEFAULT_DISTRO_FEATURES}"


# enable mdev/busybox for init
INIT_MANAGER ?= "sysvinit"

MACHINE_ESSENTIAL_EXTRA_RDEPENDS = ""

# The mtrace script included by eglibc is a perl script. This means the system
# will build perl in case this package is installed. Since we don't care about
# this script for the purposes of tiny, remove the dependency from here.
RDEPENDS:${PN}-mtrace:pn-eglibc = ""

SKIP_RECIPE[build-appliance-image] = "not buildable with openbouffalo"
SKIP_RECIPE[core-image-rt] = "not buildable with openbouffalo"
SKIP_RECIPE[core-image-rt-sdk] = "not buildable with openbouffalo"
SKIP_RECIPE[core-image-sato] = "not buildable with openbouffalo"
SKIP_RECIPE[core-image-sato-dev] = "not buildable with openbouffalo"
SKIP_RECIPE[core-image-sato-sdk] = "not buildable with openbouffalo"
SKIP_RECIPE[core-image-x11] = "not buildable with openbouffalo"
SKIP_RECIPE[core-image-weston] = "not buildable with openbouffalo"


# Disable python usage in opkg-utils since it won't build with tiny config
PACKAGECONFIG:remove:pn-opkg-utils = "python"

SDK_NAME = "${DISTRO}-${TCLIBC}-${SDKMACHINE}-${IMAGE_BASENAME}-${TUNE_PKGARCH}-${MACHINE}"
SDKPATHINSTALL = "/opt/${DISTRO}/${SDK_VERSION}"

PACKAGE_CLASSES = "package_deb"

DISTRO_FEATURES_BACKFILL_CONSIDERED += "sysvinit"
VIRTUAL-RUNTIME_init_manager = "sysvinit"
PREFERRED_RPROVIDER_ssh = "dropbear"
HOSTTOOLS_NONFATAL:append = " ssh"

PACKAGE_FEED_URIS = "https://openbouffalo.my-ho.st:8443/deploy/openbouffalo/deb/"
PACKAGE_FEED_ARCHS = "all bl808 riscv64"

IMAGE_FSTYPES = "tar.gz wic.xz"
WKS_FILE="sdcard.wks"
```

## conf/layer.conf
```bitbake
# We have a conf and classes directory, add to BBPATH
BBPATH .= ":${LAYERDIR}"

# We have recipes-* directories, add to BBFILES
BBFILES += "${LAYERDIR}/recipes-*/*/*.bb \
            ${LAYERDIR}/recipes-*/*/*.bbappend"

BBFILE_COLLECTIONS += "meta-openbouffalo"
BBFILE_PATTERN_meta-openbouffalo = "^${LAYERDIR}/"
BBFILE_PRIORITY_meta-openbouffalo = "8"

LAYERDEPENDS_meta-openbouffalo = "meta-bl808"
LAYERSERIES_COMPAT_meta-openbouffalo = "kirkstone"


#git checkout failure
COMPATIBLE_HOST:pn-openwsman:riscv64 = "null"
#missing file
COMPATIBLE_HOST:pn-linux-firmware-beaglev-bcm43430:riscv64 = "null"
#git checkout failure
COMPATIBLE_HOST:pn-exprtk:riscv64 = "null"
#Can't exec "autopoint": No such file or directory at
COMPATIBLE_HOST:pn-libconfuse:riscv64 = "null"
#depends on libconfuse
COMPATIBLE_HOST:pn-bmon:riscv64 = "null"
#more undefined references to `su_cs_is_space' follow
COMPATIBLE_HOST:pn-s-nail:riscv64 = "null"
#depends on s-nail
COMPATIBLE_HOST:pn-smartmontools:riscv64 = "null"
#ABOUT-NLS': No such file or directory
COMPATIBLE_HOST:pn-zbar:riscv64 = "null"
#./bootstrap: Please install the prerequisite programs
COMPATIBLE_HOST:pn-netcf:riscv64 = "null"
# Too much memory required for compiler. bleh
COMPATIBLE_HOST:pn-mozjs:riscv64 = "null"
COMPATIBLE_HOST:pn-mozjs-91:riscv64 = "null"
#cc1: all warnings being treated as errors
COMPATIBLE_HOST:pn-indent:riscv64 = "null"
#cc1: all warnings being treated as errors
COMPATIBLE_HOST:pn-poke:riscv64 = "null"
#cc1: all warnings being treated as errors
COMPATIBLE_HOST:pn-opensaf:riscv64 = "null"
COMPATIBLE_HOST:pn-fluentbit:riscv64 = "null"
#undefined section `netdefs_offset' referenced in expression
COMPATIBLE_HOST:pn-netplan:riscv64 = "null"
#configure: error: could not force soft-float
COMPATIBLE_HOST:pn-grub-efi:riscv64 = "null"
COMPATIBLE_HOST:pn-grub:riscv64 = "null"
```

## conf/machine/pine64-ox64.conf
```bitbake
#@TYPE: Machine
#@NAME: Pine64 OX64 SBC
#@DESCRIPTION: Machine configuration for Pine64 OX64

require conf/machine/bl808.conf

IMAGE_FSTYPES = "tar.gz wic.xz"
WKS_FILE="sdcard.wks"
```

## wic/sdcard.wks
```
# short-description: Example of partitioned image with complex layout
# long-description: This image contains boot partition and 3 rootfs partitions
# created from core-image-minimal and wic-image-minimal image recipes.

part --fstype swap --size 1G --ondisk mmcblk0 --label swap --part-name swap
part /boot --source bootimg-partition --ondisk mmcblk0 --fstype=vfat --label boot --part-name boot --active --align 1024 --size 200M --extra-space 0
part / --source rootfs --ondisk mmcblk0 --fstype=ext4 --label rootfs --part-name rootfs --align 1024 --use-uuid

bootloader --ptable gpt
```
